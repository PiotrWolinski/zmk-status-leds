## Kconfig
```kconfig
menuconfig ZMK_STATUS_LEDS
    bool "ZMK Status LEDs indicator support"
    default n
    depends on LED_STRIP
    help
      Enable status signaling (Bluetooth and battery) via addressable RGB LEDs.

if ZMK_STATUS_LEDS

config ZMK_BEHAVIOR_STATUS_LEDS
    bool "Status LEDs keymap behavior"
    default y
    help
      Enable the keymap behavior (&status_bat, &status_bt, &status_discover) to trigger status LEDs on key press.

config ZMK_STATUS_LEDS_BRIGHTNESS
    int "LED brightness (1-255)"
    default 32
    range 1 255
    help
      Maximum RGB channel value used for status indicators. Keep low to save battery.

config ZMK_STATUS_LEDS_DURATION_MS
    int "Duration (ms) to display status before turning LEDs off"
    default 3000
    help
      How long the battery or Bluetooth indicator remains active before clearing the strip.

config ZMK_STATUS_LEDS_FAST_BLINK_MS
    int "Fast blink interval (ms) for pairing / connected flash"
    default 150
    help
      Toggle interval in milliseconds for fast flashing (e.g. unoccupied slot pairing).

config ZMK_STATUS_LEDS_SLOW_BLINK_MS
    int "Slow blink interval (ms) when waiting for connection"
    default 500
    help
      Toggle interval in milliseconds for slow blinking (occupied slot waiting to connect).

config ZMK_STATUS_LEDS_DISCOVER_STEP_MS
    int "Step duration (ms) per LED during discovery mode"
    default 1000
    help
      How long each individual LED stays lit when running &status_discover.

endif # ZMK_STATUS_LEDS
```

## dts/bindings/behaviors/zmk,behavior-status-leds.yaml
```yaml
description: ZMK Status LEDs behavior

compatible: "zmk,behavior-status-leds"

include: zero_param.yaml

properties:
  indicate-battery:
    type: boolean
    description: Trigger the battery level display when pressed
  indicate-bt:
    type: boolean
    description: Trigger the Bluetooth connection status display when pressed
```

## dts/bindings/zmk,status-leds.yaml
```yaml
description: Configuration node for ZMK Status LEDs physical mapping

compatible: "zmk,status-leds"

properties:
  led-strip:
    type: phandle
    required: false
    description: Reference to the physical LED strip device (e.g., &led_strip)
  battery-leds:
    type: array
    required: false
    description: Array of physical LED indices used to display battery thresholds
  bt-leds:
    type: array
    required: false
    description: Array of physical LED indices corresponding to Bluetooth profile slots
```
